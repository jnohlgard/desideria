/* *** Generated with Desideria SVD converter *** */
/* Hardware module map for FE310 */
/* The FE310-G000 is the first Freedom E300 SoC, and forms the basis of the HiFive1 development board for the Freedom E300 family. The FE310-G000 is built around the E31 Coreplex instantiated in the Freedom E300 platform. */
PROVIDE(CLINT$           = 0x2000000);
PROVIDE(PLIC$            = 0xc000000);
PROVIDE(WDOG$            = 0x10000000);
PROVIDE(RTC$             = 0x10000040);
PROVIDE(AONCLK$          = 0x10000070);
PROVIDE(BACKUP$          = 0x10000080);
PROVIDE(PMU$             = 0x10000100);
PROVIDE(PRCI$            = 0x10008000);
PROVIDE(OTP$             = 0x10010000);
PROVIDE(GPIO$            = 0x10012000);
PROVIDE(UART0$           = 0x10013000);
PROVIDE(QSPI0$           = 0x10014000);
PROVIDE(PWM0$            = 0x10015000);
PROVIDE(I2C0$            = 0x10016000);
PROVIDE(UART1$           = 0x10023000);
PROVIDE(QSPI1$           = 0x10024000);
PROVIDE(PWM1$            = 0x10025000);
PROVIDE(QSPI2$           = 0x10034000);
PROVIDE(PWM2$            = 0x10035000);
PROVIDE(MSIP$            = 0x02000000);
PROVIDE(MTIMECMP$        = 0x02004000);
PROVIDE(MTIMECMPH$       = 0x02004004);
PROVIDE(MTIME$           = 0x0200bff8);
PROVIDE(MTIMEH$          = 0x0200bffc);

/* C++ mangled names below */
PROVIDE(_ZN4deri4mmio5CLINTE = CLINT$);
PROVIDE(_ZN4deri4mmio4PLICE = PLIC$);
PROVIDE(_ZN4deri4mmio4WDOGE = WDOG$);
PROVIDE(_ZN4deri4mmio3RTCE = RTC$);
PROVIDE(_ZN4deri4mmio6AONCLKE = AONCLK$);
PROVIDE(_ZN4deri4mmio6BACKUPE = BACKUP$);
PROVIDE(_ZN4deri4mmio3PMUE = PMU$);
PROVIDE(_ZN4deri4mmio4PRCIE = PRCI$);
PROVIDE(_ZN4deri4mmio3OTPE = OTP$);
PROVIDE(_ZN4deri4mmio4GPIOE = GPIO$);
PROVIDE(_ZN4deri4mmio5UART0E = UART0$);
PROVIDE(_ZN4deri4mmio5QSPI0E = QSPI0$);
PROVIDE(_ZN4deri4mmio4PWM0E = PWM0$);
PROVIDE(_ZN4deri4mmio4I2C0E = I2C0$);
PROVIDE(_ZN4deri4mmio5UART1E = UART1$);
PROVIDE(_ZN4deri4mmio5QSPI1E = QSPI1$);
PROVIDE(_ZN4deri4mmio4PWM1E = PWM1$);
PROVIDE(_ZN4deri4mmio5QSPI2E = QSPI2$);
PROVIDE(_ZN4deri4mmio4PWM2E = PWM2$);
PROVIDE(_ZN4deri4mmio5mtimeE = MTIME$);
PROVIDE(_ZN4deri4mmio8mtimecmpE = MTIMECMP$);


/* Interrupt handlers weakly defined to point to the default handler */
PROVIDE(isr_unhandled = deri_arch_unhandled_interrupt);
PROVIDE(isr_unused = isr_unhandled);
PROVIDE(isr_mtime = isr_unhandled);
PROVIDE(isr_software = isr_unhandled);
PROVIDE(plic_unhandled = 0);
PROVIDE(plic_unused = plic_unhandled);
PROVIDE(plic_WATCHDOG = plic_unhandled);
PROVIDE(plic_RTC = plic_unhandled);
PROVIDE(plic_UART0 = plic_unhandled);
PROVIDE(plic_UART1 = plic_unhandled);
PROVIDE(plic_QSPI0 = plic_unhandled);
PROVIDE(plic_QSPI1 = plic_unhandled);
PROVIDE(plic_QSPI2 = plic_unhandled);
PROVIDE(plic_GPIO0 = plic_unhandled);
PROVIDE(plic_GPIO1 = plic_unhandled);
PROVIDE(plic_GPIO2 = plic_unhandled);
PROVIDE(plic_GPIO3 = plic_unhandled);
PROVIDE(plic_GPIO4 = plic_unhandled);
PROVIDE(plic_GPIO5 = plic_unhandled);
PROVIDE(plic_GPIO6 = plic_unhandled);
PROVIDE(plic_GPIO7 = plic_unhandled);
PROVIDE(plic_GPIO8 = plic_unhandled);
PROVIDE(plic_GPIO9 = plic_unhandled);
PROVIDE(plic_GPIO10 = plic_unhandled);
PROVIDE(plic_GPIO11 = plic_unhandled);
PROVIDE(plic_GPIO12 = plic_unhandled);
PROVIDE(plic_GPIO13 = plic_unhandled);
PROVIDE(plic_GPIO14 = plic_unhandled);
PROVIDE(plic_GPIO15 = plic_unhandled);
PROVIDE(plic_GPIO16 = plic_unhandled);
PROVIDE(plic_GPIO17 = plic_unhandled);
PROVIDE(plic_GPIO18 = plic_unhandled);
PROVIDE(plic_GPIO19 = plic_unhandled);
PROVIDE(plic_GPIO20 = plic_unhandled);
PROVIDE(plic_GPIO21 = plic_unhandled);
PROVIDE(plic_GPIO22 = plic_unhandled);
PROVIDE(plic_GPIO23 = plic_unhandled);
PROVIDE(plic_GPIO24 = plic_unhandled);
PROVIDE(plic_GPIO25 = plic_unhandled);
PROVIDE(plic_GPIO26 = plic_unhandled);
PROVIDE(plic_GPIO27 = plic_unhandled);
PROVIDE(plic_GPIO28 = plic_unhandled);
PROVIDE(plic_GPIO29 = plic_unhandled);
PROVIDE(plic_GPIO30 = plic_unhandled);
PROVIDE(plic_GPIO31 = plic_unhandled);
PROVIDE(plic_PWM0CMP0 = plic_unhandled);
PROVIDE(plic_PWM0CMP1 = plic_unhandled);
PROVIDE(plic_PWM0CMP2 = plic_unhandled);
PROVIDE(plic_PWM0CMP3 = plic_unhandled);
PROVIDE(plic_PWM1CMP0 = plic_unhandled);
PROVIDE(plic_PWM1CMP1 = plic_unhandled);
PROVIDE(plic_PWM1CMP2 = plic_unhandled);
PROVIDE(plic_PWM1CMP3 = plic_unhandled);
PROVIDE(plic_PWM2CMP0 = plic_unhandled);
PROVIDE(plic_PWM2CMP1 = plic_unhandled);
PROVIDE(plic_PWM2CMP2 = plic_unhandled);
PROVIDE(plic_PWM2CMP3 = plic_unhandled);
PROVIDE(plic_I2C0 = plic_unhandled);
