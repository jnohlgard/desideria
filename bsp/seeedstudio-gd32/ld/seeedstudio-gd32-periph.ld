/* Mapping logical devices onto hardware registers */

PROVIDE(_ZN4deri3bsp5uart0E = USART0$);
PROVIDE(_ZN4deri3bsp5uart1E = USART1$);
PROVIDE(_ZN4deri3bsp5uart2E = USART2$);
PROVIDE(_ZN4deri3bsp5uart3E = UART3$);
PROVIDE(_ZN4deri3bsp5uart4E = UART4$);
PROVIDE(_ZN4deri3bsp3rcuE = RCU$);
PROVIDE(_ZN4deri3bsp5gpioaE = GPIOA$);
PROVIDE(_ZN4deri3bsp5gpiobE = GPIOB$);
PROVIDE(_ZN4deri3bsp5gpiocE = GPIOC$);
PROVIDE(_ZN4deri3bsp5gpiodE = GPIOD$);
PROVIDE(_ZN4deri3bsp5gpioeE = GPIOE$);
