
PROVIDE(_ZN4deri3soc5gpioaE = GPIOA$);
PROVIDE(_ZN4deri3soc5gpiobE = GPIOB$);
PROVIDE(_ZN4deri3soc5gpiocE = GPIOC$);
PROVIDE(_ZN4deri3soc5gpiodE = GPIOD$);
PROVIDE(_ZN4deri3soc5gpioeE = GPIOE$);
PROVIDE(_ZN4deri3soc4afioE = AFIO$);
PROVIDE(_ZN4deri3soc4extiE = EXTI$);
PROVIDE(_ZN4deri3soc4clicE = ECLIC$);
PROVIDE(_ZN4deri3soc3rcuE = RCU$);
PROVIDE(_ZN4deri3soc6timer0E = TIMER0$);
PROVIDE(_ZN4deri3soc6timer1E = TIMER1$);
PROVIDE(_ZN4deri3soc6timer2E = TIMER2$);
PROVIDE(_ZN4deri3soc6timer3E = TIMER3$);
PROVIDE(_ZN4deri3soc6timer4E = TIMER4$);
PROVIDE(_ZN4deri3soc6timer5E = TIMER5$);
PROVIDE(_ZN4deri3soc6timer6E = TIMER6$);
PROVIDE(_ZN4deri3bsp5uart0E = USART0$);
PROVIDE(_ZN4deri3bsp5uart1E = USART1$);
PROVIDE(_ZN4deri3bsp5uart2E = USART2$);
PROVIDE(_ZN4deri3bsp5uart3E = UART3$);
PROVIDE(_ZN4deri3bsp5uart4E = UART4$);
