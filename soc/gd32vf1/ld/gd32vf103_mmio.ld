/* *** Generated with Desideria SVD converter *** */
/* Hardware module map for GD32VF103 */
/* GD32VF103 RISC-V Microcontroller based device */
PROVIDE(ADC0$            = 0x40012400);
PROVIDE(ADC1$            = 0x40012800);
PROVIDE(AFIO$            = 0x40010000);
PROVIDE(BKP$             = 0x40006c00);
PROVIDE(CAN0$            = 0x40006400);
PROVIDE(CAN1$            = 0x40006800);
PROVIDE(CRC$             = 0x40023000);
PROVIDE(DAC$             = 0x40007400);
PROVIDE(DBG$             = 0xe0042000);
PROVIDE(DMA0$            = 0x40020000);
PROVIDE(DMA1$            = 0x40020000);
PROVIDE(EXMC$            = 0xa0000000);
PROVIDE(EXTI$            = 0x40010400);
PROVIDE(FMC$             = 0x40022000);
PROVIDE(FWDGT$           = 0x40003000);
PROVIDE(GPIOA$           = 0x40010800);
PROVIDE(GPIOB$           = 0x40010c00);
PROVIDE(GPIOC$           = 0x40011000);
PROVIDE(GPIOD$           = 0x40011400);
PROVIDE(GPIOE$           = 0x40011800);
PROVIDE(I2C0$            = 0x40005400);
PROVIDE(I2C1$            = 0x40005800);
PROVIDE(ECLIC$           = 0xd2000000);
PROVIDE(PMU$             = 0x40007000);
PROVIDE(RCU$             = 0x40021000);
PROVIDE(RTC$             = 0x40002800);
PROVIDE(SPI0$            = 0x40013000);
PROVIDE(SPI1$            = 0x40003800);
PROVIDE(SPI2$            = 0x40003c00);
PROVIDE(TIMER0$          = 0x40012c00);
PROVIDE(TIMER1$          = 0x40000000);
PROVIDE(TIMER2$          = 0x40000400);
PROVIDE(TIMER3$          = 0x40000800);
PROVIDE(TIMER4$          = 0x40000c00);
PROVIDE(TIMER5$          = 0x40001000);
PROVIDE(TIMER6$          = 0x40001400);
PROVIDE(USART0$          = 0x40013800);
PROVIDE(USART1$          = 0x40004400);
PROVIDE(USART2$          = 0x40004800);
PROVIDE(UART3$           = 0x40004c00);
PROVIDE(UART4$           = 0x40005000);
PROVIDE(USBFS_GLOBAL$    = 0x50000000);
PROVIDE(USBFS_HOST$      = 0x50000400);
PROVIDE(USBFS_DEVICE$    = 0x50000800);
PROVIDE(USBFS_PWRCLK$    = 0x50000e00);
PROVIDE(WWDGT$           = 0x40002c00);
PROVIDE(MTIME$           = 0xd1000000);
PROVIDE(MTIMEH$          = 0xd1000004);
PROVIDE(MTIMECMP$        = 0xd1000008);
PROVIDE(MTIMECMPH$       = 0xd100000c);
PROVIDE(MSTOP$           = 0xd1000ff8);
PROVIDE(MSIP$            = 0xd1000ffc);

/* C++ mangled names below */
PROVIDE(_ZN4deri4mmio4ADC0E = ADC0$);
PROVIDE(_ZN4deri4mmio4ADC1E = ADC1$);
PROVIDE(_ZN4deri4mmio4AFIOE = AFIO$);
PROVIDE(_ZN4deri4mmio3BKPE = BKP$);
PROVIDE(_ZN4deri4mmio4CAN0E = CAN0$);
PROVIDE(_ZN4deri4mmio4CAN1E = CAN1$);
PROVIDE(_ZN4deri4mmio3CRCE = CRC$);
PROVIDE(_ZN4deri4mmio3DACE = DAC$);
PROVIDE(_ZN4deri4mmio3DBGE = DBG$);
PROVIDE(_ZN4deri4mmio4DMA0E = DMA0$);
PROVIDE(_ZN4deri4mmio4DMA1E = DMA1$);
PROVIDE(_ZN4deri4mmio4EXMCE = EXMC$);
PROVIDE(_ZN4deri4mmio4EXTIE = EXTI$);
PROVIDE(_ZN4deri4mmio3FMCE = FMC$);
PROVIDE(_ZN4deri4mmio5FWDGTE = FWDGT$);
PROVIDE(_ZN4deri4mmio5GPIOAE = GPIOA$);
PROVIDE(_ZN4deri4mmio5GPIOBE = GPIOB$);
PROVIDE(_ZN4deri4mmio5GPIOCE = GPIOC$);
PROVIDE(_ZN4deri4mmio5GPIODE = GPIOD$);
PROVIDE(_ZN4deri4mmio5GPIOEE = GPIOE$);
PROVIDE(_ZN4deri4mmio4I2C0E = I2C0$);
PROVIDE(_ZN4deri4mmio4I2C1E = I2C1$);
PROVIDE(_ZN4deri4mmio4CLICE = ECLIC$);
PROVIDE(_ZN4deri4mmio3PMUE = PMU$);
PROVIDE(_ZN4deri4mmio3RCUE = RCU$);
PROVIDE(_ZN4deri4mmio3RTCE = RTC$);
PROVIDE(_ZN4deri4mmio4SPI0E = SPI0$);
PROVIDE(_ZN4deri4mmio4SPI1E = SPI1$);
PROVIDE(_ZN4deri4mmio4SPI2E = SPI2$);
PROVIDE(_ZN4deri4mmio6TIMER0E = TIMER0$);
PROVIDE(_ZN4deri4mmio6TIMER1E = TIMER1$);
PROVIDE(_ZN4deri4mmio6TIMER2E = TIMER2$);
PROVIDE(_ZN4deri4mmio6TIMER3E = TIMER3$);
PROVIDE(_ZN4deri4mmio6TIMER4E = TIMER4$);
PROVIDE(_ZN4deri4mmio6TIMER5E = TIMER5$);
PROVIDE(_ZN4deri4mmio6TIMER6E = TIMER6$);
PROVIDE(_ZN4deri4mmio6USART0E = USART0$);
PROVIDE(_ZN4deri4mmio6USART1E = USART1$);
PROVIDE(_ZN4deri4mmio6USART2E = USART2$);
PROVIDE(_ZN4deri4mmio5UART3E = UART3$);
PROVIDE(_ZN4deri4mmio5UART4E = UART4$);
PROVIDE(_ZN4deri4mmio12USBFS_GLOBALE = USBFS_GLOBAL$);
PROVIDE(_ZN4deri4mmio10USBFS_HOSTE = USBFS_HOST$);
PROVIDE(_ZN4deri4mmio12USBFS_DEVICEE = USBFS_DEVICE$);
PROVIDE(_ZN4deri4mmio12USBFS_PWRCLKE = USBFS_PWRCLK$);
PROVIDE(_ZN4deri4mmio5WWDGTE = WWDGT$);
PROVIDE(_ZN4deri4mmio5mtimeE = MTIME$);
PROVIDE(_ZN4deri4mmio8mtimecmpE = MTIMECMP$);


/* Interrupt handlers weakly defined to point to the default handler */
PROVIDE(isr_unhandled = deri_arch_unhandled_interrupt);
PROVIDE(isr_unused = isr_unhandled);
PROVIDE(isr_CLIC_INT_SFT = isr_unhandled);
PROVIDE(isr_CLIC_INT_TMR = isr_unhandled);
PROVIDE(isr_CLIC_INT_BWEI = isr_unhandled);
PROVIDE(isr_CLIC_INT_PMOVI = isr_unhandled);
PROVIDE(isr_WWDGT = isr_unhandled);
PROVIDE(isr_LVD = isr_unhandled);
PROVIDE(isr_Tamper = isr_unhandled);
PROVIDE(isr_RTC = isr_unhandled);
PROVIDE(isr_FMC = isr_unhandled);
PROVIDE(isr_RCU = isr_unhandled);
PROVIDE(isr_EXTI_Line0 = isr_unhandled);
PROVIDE(isr_EXTI_Line1 = isr_unhandled);
PROVIDE(isr_EXTI_Line2 = isr_unhandled);
PROVIDE(isr_EXTI_Line3 = isr_unhandled);
PROVIDE(isr_EXTI_Line4 = isr_unhandled);
PROVIDE(isr_DMA0_Channel0 = isr_unhandled);
PROVIDE(isr_DMA0_Channel1 = isr_unhandled);
PROVIDE(isr_DMA0_Channel2 = isr_unhandled);
PROVIDE(isr_DMA0_Channel3 = isr_unhandled);
PROVIDE(isr_DMA0_Channel4 = isr_unhandled);
PROVIDE(isr_DMA0_Channel5 = isr_unhandled);
PROVIDE(isr_DMA0_Channel6 = isr_unhandled);
PROVIDE(isr_ADC0_1 = isr_unhandled);
PROVIDE(isr_CAN0_TX = isr_unhandled);
PROVIDE(isr_CAN0_RX0 = isr_unhandled);
PROVIDE(isr_CAN0_RX1 = isr_unhandled);
PROVIDE(isr_CAN0_EWMC = isr_unhandled);
PROVIDE(isr_EXTI_line9_5 = isr_unhandled);
PROVIDE(isr_TIMER0_BRK = isr_unhandled);
PROVIDE(isr_TIMER0_UP = isr_unhandled);
PROVIDE(isr_TIMER0_TRG_CMT = isr_unhandled);
PROVIDE(isr_TIMER0_Channel = isr_unhandled);
PROVIDE(isr_TIMER1 = isr_unhandled);
PROVIDE(isr_TIMER2 = isr_unhandled);
PROVIDE(isr_TIMER3 = isr_unhandled);
PROVIDE(isr_I2C0_EV = isr_unhandled);
PROVIDE(isr_I2C0_ER = isr_unhandled);
PROVIDE(isr_I2C1_EV = isr_unhandled);
PROVIDE(isr_I2C1_ER = isr_unhandled);
PROVIDE(isr_SPI0 = isr_unhandled);
PROVIDE(isr_SPI1 = isr_unhandled);
PROVIDE(isr_USART0 = isr_unhandled);
PROVIDE(isr_USART1 = isr_unhandled);
PROVIDE(isr_USART2 = isr_unhandled);
PROVIDE(isr_EXTI_line15_10 = isr_unhandled);
PROVIDE(isr_RTC_Alarm = isr_unhandled);
PROVIDE(isr_USBFS_WKUP = isr_unhandled);
PROVIDE(isr_TIMER4 = isr_unhandled);
PROVIDE(isr_SPI2 = isr_unhandled);
PROVIDE(isr_UART3 = isr_unhandled);
PROVIDE(isr_UART4 = isr_unhandled);
PROVIDE(isr_TIMER5 = isr_unhandled);
PROVIDE(isr_TIMER6 = isr_unhandled);
PROVIDE(isr_DMA1_Channel0 = isr_unhandled);
PROVIDE(isr_DMA1_Channel1 = isr_unhandled);
PROVIDE(isr_DMA1_Channel2 = isr_unhandled);
PROVIDE(isr_DMA1_Channel3 = isr_unhandled);
PROVIDE(isr_DMA1_Channel4 = isr_unhandled);
PROVIDE(isr_CAN1_TX = isr_unhandled);
PROVIDE(isr_CAN1_RX0 = isr_unhandled);
PROVIDE(isr_CAN1_RX1 = isr_unhandled);
PROVIDE(isr_CAN1_EWMC = isr_unhandled);
PROVIDE(isr_USBFS = isr_unhandled);
