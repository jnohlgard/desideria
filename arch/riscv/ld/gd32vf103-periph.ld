/* Source: GD32VF103 User Manual revision 1.2 */
PROVIDE(TIMER1$   = 0x40000000);
PROVIDE(TIMER2$   = 0x40000400);
PROVIDE(TIMER3$   = 0x40000800);
PROVIDE(TIMER4$   = 0x40000C00);
PROVIDE(TIMER5$   = 0x40001000);
PROVIDE(TIMER6$   = 0x40001400);
PROVIDE(RTC$      = 0x40002800);
PROVIDE(WWDGT$    = 0x40002C00);
PROVIDE(FWDGT$    = 0x40003000);
PROVIDE(SPI1$     = 0x40003800);
PROVIDE(SPI2$     = 0x40003C00);
PROVIDE(USART1$   = 0x40004400);
PROVIDE(USART2$   = 0x40004800);
PROVIDE(UART3$    = 0x40004C00);
PROVIDE(UART4$    = 0x40005000);
PROVIDE(I2C0$     = 0x40005400);
PROVIDE(I2C1$     = 0x40005800);
PROVIDE(USBDevFS$ = 0x40005C00);
PROVIDE(USBRAM$   = 0x40006000);
PROVIDE(CAN0$     = 0x40006400);
PROVIDE(CAN1$     = 0x40006800);
PROVIDE(BKP$      = 0x40006C00);
PROVIDE(PMU$      = 0x40007000);
PROVIDE(DAC$      = 0x40007400);
PROVIDE(AFIO$     = 0x40010000);
PROVIDE(EXTI$     = 0x40010400);
PROVIDE(GPIOA$    = 0x40010800);
PROVIDE(GPIOB$    = 0x40010C00);
PROVIDE(GPIOC$    = 0x40011000);
PROVIDE(GPIOD$    = 0x40011400);
PROVIDE(GPIOE$    = 0x40011800);
PROVIDE(ADC0$     = 0x40012400);
PROVIDE(ADC1$     = 0x40012800);
PROVIDE(TIMER0$   = 0x40012C00);
PROVIDE(SPI0$     = 0x40013000);
PROVIDE(USART0$   = 0x40013800);
PROVIDE(DMA0$     = 0x40020000);
PROVIDE(DMA1$     = 0x40020400);
PROVIDE(RCU$      = 0x40021000);
PROVIDE(FMC$      = 0x40022000);
PROVIDE(CRC$      = 0x40023000);
PROVIDE(USBFS$    = 0x50000000);
PROVIDE(DBG$      = 0xE0042000);

INCLUDE periph-cpp.ld
